## drivers/input/fingerprint/Kconfig
```kconfig
menuconfig BBK_FINGERPRINT
	tristate "BBK FINGERPRINT support"
	help
	  Say Y here to enable fingerprint

if BBK_FINGERPRINT
config BBK_FP_MODULE
	bool "BBK fingerprint modules"
	help
		Say Y here to enable fingerprint modules
config BBK_FP_ID
	tristate "detect fingerprint id"
	help
	  there is nothing for help!

source "drivers/input/fingerprint/gf9518/Kconfig"
source "drivers/input/fingerprint/gf3208/Kconfig"
source "drivers/input/fingerprint/fpc1511/Kconfig"
source "drivers/input/fingerprint/et713/Kconfig"
source "drivers/input/fingerprint/gsl7001/Kconfig"
source "drivers/input/fingerprint/nvt16605/Kconfig"
source "drivers/input/fingerprint/gf9578/Kconfig"
source "drivers/input/fingerprint/gf3956/Kconfig"
endif
```

## drivers/input/fingerprint/et713/Kconfig
```kconfig
config BBK_ET713
  tristate "EGISTEC OEM fingerprint BBK_ET713 support"
  default n
  help
    Egistec Fingerprint chip ET713 TEE driver
```

## drivers/input/fingerprint/gf3956/Kconfig
```kconfig
config BBK_GF3956
	tristate "Goodix GF3626 fingerprint drvier support"
	help
	  Say Y here to enable goodix fingerprint driver support!
```

## drivers/input/fingerprint/gf9578/Kconfig
```kconfig
config BBK_GF9578
	tristate "Goodix GF9578 fingerprint drvier support"
	help
	  Say Y here to enable goodix fingerprint driver support!
```

## drivers/input/fingerprint/nvt16605/Kconfig
```kconfig
config BBK_NVT16605
  tristate "NOVATEK OEM fingerprint BBK_NT16602 support"
  default n
  help
    Novatek Fingerprint chip NT16605 TEE driver
```

## drivers/misc/mediatek/sensor/2.0/mtk_nanohub/Kconfig
```kconfig
config SUPPORT_ALS_CCT
	bool "support als cct"
	default n
	help
	  It support als cct
```

## drivers/misc/vibrator/Kconfig
```kconfig
config HAPTICS_DRIVER
    tristate "VIVO Haptics CORE support"
	default y
    help
        This option enables vibrator class driver support for not input-ff framework vibrator driver.
        Mainly used for the third party peripheral chip.
```

## drivers/nfc/sn100_spi/Kconfig
```kconfig
config SN100_SPI
	bool "sn100 NFC spi clk control"
	default n
config SEC_NFC
	bool "SEC NFC"
	default n
```

## drivers/soc/vivo/Kconfig
```kconfig
menu "SOC (System On Chip) specific Drivers"

source "drivers/soc/vivo/vivo_bsp_info/Kconfig"

endmenu
```

## drivers/soc/vivo/vivo_bsp_info/Kconfig
```kconfig
config VIVO_BSP_INFO
	tristate "vivo bsp info"
	help
	  This module provides bsp info support,ex:board_info,board_version,card_detected.
```

## kernel/Kconfig.freezer
```kconfig
config FREEZER
	def_bool PM_SLEEP || CGROUP_FREEZER

config RSC_FREEZER
	bool "rsc values for freezer."
	depends on FREEZER
	default y
```
